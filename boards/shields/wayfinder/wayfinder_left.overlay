#include "wayfinder.dtsi"

&kscan0 {
    col-gpios
        = <&gpio0 31 GPIO_ACTIVE_HIGH>  // Pro Micro 2 -> P0.31
        , <&gpio0 29 GPIO_ACTIVE_HIGH>  // Pro Micro 3 -> P0.29
        , <&gpio0 2  GPIO_ACTIVE_HIGH>  // Pro Micro 4 -> P0.02
        , <&gpio1 15 GPIO_ACTIVE_HIGH>  // Pro Micro 5 -> P1.15
        , <&gpio1 13 GPIO_ACTIVE_HIGH>  // Pro Micro 6 -> P1.13
        , <&gpio1 11 GPIO_ACTIVE_HIGH>  // Pro Micro 7 -> P1.11
        ;
};