## boards/shields/wayfinder/Kconfig.shield
```kconfig
config SHIELD_WAYFINDER_LEFT
    def_bool $(shields_list_contains,wayfinder_left)

config SHIELD_WAYFINDER_RIGHT
    def_bool $(shields_list_contains,wayfinder_right)
```

## config/boards/shields/Kconfig.defconfig
```kconfig
if SHIELD_WAYFINDER_LEFT

config ZMK_KEYBOARD_NAME
    default "Wayfinder"

config ZMK_SPLIT_ROLE_CENTRAL
    default y

endif

if SHIELD_WAYFINDER_LEFT || SHIELD_WAYFINDER_RIGHT

config ZMK_SPLIT
    default y

endif
```

## config/west.yml
```yaml
manifest:
  defaults:
    revision: v0.3
  remotes:
    - name: zmkfirmware
      url_base: https://github.com/zmkfirmware
    - name: joelspadin
      url_base: https://github.com/joelspadin
  projects:
    - name: zmk
      remote: zmkfirmware
      import: app/west.yml
    - name: zmk-locale
      remote: joelspadin
      revision: main
  self:
    path: config
```
